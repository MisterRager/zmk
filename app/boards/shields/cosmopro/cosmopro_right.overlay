#include "cosmopro.dtsi"

/ {
    bootloader_key: bootloader_key {
        compatible = "zmk,boot-magic-key";
        key-position = <53>;
        jump-to-bootloader;
    };
};

&default_transform {
    col-offset = <7>;
};
