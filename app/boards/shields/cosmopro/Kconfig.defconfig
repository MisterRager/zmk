## app/boards/shields/cosmopro/Kconfig.defconfig
```kconfig
if SHIELD_cosmopro_LEFT

config ZMK_KEYBOARD_NAME
    default "cosmo-pro"

config ZMK_SPLIT_ROLE_CENTRAL
    default y

endif # SHIELD_cosmopro_LEFT

if SHIELD_cosmopro_LEFT || SHIELD_cosmopro_RIGHT

config ZMK_SPLIT
    default y

endif # SHIELD_cosmopro_LEFT || SHIELD_cosmopro_RIGHT
```

## app/boards/shields/cosmopro/Kconfig.shield
```kconfig
config SHIELD_cosmopro_LEFT
    def_bool $(shields_list_contains,cosmopro_left)

config SHIELD_cosmopro_RIGHT
    def_bool $(shields_list_contains,cosmopro_right)
```
